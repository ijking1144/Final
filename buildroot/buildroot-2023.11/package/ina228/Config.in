## buildroot/buildroot-2023.11/package/ina228/Config.in
```kconfig
config BR2_PACKAGE_INA228
    bool "ina228 userspace utility"
    help
      Utility to communicate with the INA228 power monitor over I2C.
```

## buildroot/buildroot-2023.11/package/sd-card/Config.in
```kconfig
config BR2_PACKAGE_SD_CARD
    bool "sd kernelspace utility"
    help
      Utility to communicate with the sd card
```

## buildroot/buildroot-2023.11/package/um982/Config.in
```kconfig
config BR2_PACKAGE_UM982
    bool "um982 userspace utility"
    help
      Utility to communicate with the um982
```
